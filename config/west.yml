## config/west.yml
```yaml
manifest:
  remotes:
    - name: zmkfirmware
      url-base: https://github.com/zmkfirmware
    - name: janpfischer
      url-base: https://github.com/janpfischer
  projects:
    - name: zmk
      remote: zmkfirmware
      revision: v.0.3.0
      import: app/west.yml
    - name: zmk-dongle-screen
      remote: janpfischer
      revision: v.0.3.0
  self:
    path: config
```
